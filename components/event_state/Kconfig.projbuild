## components/event_state/Kconfig.projbuild
```kconfig
menu "Event state machine"

    config EVENT_DOUBLE_WINDOW_MS
        int "Double-click window (ms)"
        default 300
        range 0 2000
        help
            Window after a click during which a second press upgrades to
            DOUBLE_CLICK. Set to 0 to disable — CLICK fires instantly with
            no double-click support.

    config EVENT_HOLD_THRESHOLD_MS
        int "Hold threshold (ms)"
        default 700
        range 0 10000
        help
            Press duration at which HOLD_START fires. Set to 0 to disable
            hold detection entirely.

    config EVENT_SWIPE_MIN_DISTANCE
        int "Swipe minimum distance"
        default 40
        range 0 500
        help
            Minimum finger-travel (in touchpad units) to count as a semantic
            swipe. Below this, no swipe_* event is emitted. Does not affect
            the raw touch stream.

    config EVENT_SWIPE_Y_PRIORITY
        int "Swipe Y-priority threshold"
        default 30
        range 0 200
        help
            When |dy| meets or exceeds this threshold, the swipe is classified
            as vertical (UP/DOWN) regardless of |dx|. Compensates for the
            Siri Remote touchpad's asymmetric X/Y resolution — pure vertical
            swipes routinely register large incidental X drift, and without
            this bias, swipe-down often misclassifies as swipe-left. Set to 0
            to disable and use plain |dy| > |dx| classification.

    config EVENT_PICKUP_IDLE_THRESHOLD_MS
        int "Pickup event idle threshold (ms)"
        default 5000
        range 0 600000
        help
            Minimum idle time (BLE disconnected) before a reconnect counts as
            a pickup event. Set to 0 to disable pickup events.

            On the very first connect after a bridge reboot the bridge
            substitutes its own uptime for the disconnect interval, so this
            threshold also gates whether a fresh-boot connect emits pickup.
            Keep it low enough that typical boot times (5-30s) qualify.

endmenu
```

## components/siri_ble/Kconfig.projbuild
```kconfig
menu "Siri BLE Bridge"

    config SIRI_REMOTE_MAC
        string "Siri Remote BLE MAC address"
        default "e0:c3:ea:9a:7e:d0"
        help
            BLE MAC of the Apple Siri Remote gen-3 to pair with. Gen-3 units
            use static random addresses — each unit has its own MAC, and there
            is no public OUI to filter on.

            To find yours: flash once, put the remote in pairing mode (hold
            Back + Volume Up for 5 seconds), and watch the UART for an
            advertisement at strong RSSI (> -50 dBm). The MAC on that line
            goes here. Lives in sdkconfig (gitignored), so it never enters git.

            Format: lowercase hex, colon-separated, e.g. e0:c3:ea:9a:7e:d0.

endmenu
```
